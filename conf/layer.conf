## conf/layer.conf
```bitbake
#
# Copyright (C) 2024 Wind River Systems, Inc.
#

# We have a conf and classes directory, add to BBPATH
BBPATH =. "${LAYERDIR}:"

# We have a packages directory, add to BBFILES
BBFILES += "${LAYERDIR}/recipes-*/*/*.bb \
	${LAYERDIR}/recipes-*/*/*.bbappend"

BBFILE_COLLECTIONS += "wr-ti-am62"
BBFILE_PATTERN_wr-ti-am62 := "^${LAYERDIR}/"
BBFILE_PRIORITY_wr-ti-am62 = "7"

# This should only be incremented on significant changes that will
# cause compatibility issues with other layers
LAYERVERSION_wr-ti-am62 = "1"

LAYERDEPENDS_wr-ti-am62 = "core wrlinux meta-ti-bsp meta-edgeai"

LAYERSERIES_COMPAT_wr-ti-am62 = "wrl mickledore"

WRL_RECIPES:wr-ti-am62 += " \
    tisdk-uenv \
"
```

## conf/machine/ti-am62-k3r5.conf
```bitbake
#@TYPE: Machine
#@NAME: AM62A HS-FS EVM (R5F)
#@DESCRIPTION: Machine configuration for the TI AM62A EVM (R5F core)

# Add extra essential overrides
MACHINEOVERRIDES:prepend = "k3r5:"

# The closest of existing tunes for Cortex-R5F
DEFAULTTUNE = "cortexr5"
require conf/machine/include/arm/armv7r/tune-cortexr5.inc

# Select u-boot package
PREFERRED_PROVIDER_virtual/bootloader ?= "u-boot-ti-staging"
PREFERRED_PROVIDER_u-boot ?= "u-boot-ti-staging"
PREFERRED_VERSION_u-boot-ti-staging ?= "2024.04%"

SYSFW_SOC = "am62ax"
SYSFW_CONFIG = "evm"
SYSFW_SUFFIX ?= "hs-fs"
SPL_SUFFIX = "bin"
SPL_BINARY = "tiboot3-${SYSFW_SOC}-${SYSFW_SUFFIX}-${SYSFW_CONFIG}.${SPL_SUFFIX}"
SPL_SYMLINK = "tiboot3.${SPL_SUFFIX}"
UBOOT_SUFFIX = "bin"
UBOOT_BINARY = "u-boot-r5spl.${UBOOT_SUFFIX}"
UBOOT_IMAGE = "u-boot-r5spl-${MAINMACHINE}-${PV}-${PR}.${UBOOT_SUFFIX}"
UBOOT_SYMLINK = "u-boot-r5spl-${MAINMACHINE}.${UBOOT_SUFFIX}"

PACKAGECONFIG:pn-u-boot-ti-staging = ""

UBOOT_MACHINE = "am62ax_evm_r5_defconfig"

WRTEMPLATE_BSP_PKGS = "0"
```

## conf/machine/ti-am62-secboot.inc
```bitbake
#@TYPE: Machine inc.
#@NAME: ti-am62-extra

# All the device trees for am62ax platform
KERNEL_DEVICETREE_PREFIX = "ti/k3-am62a7 ti/k3-am62x-sk ti/k3-fpdlink"

# Add extra essential overrides
MACHINEOVERRIDES:prepend = "k3:am62axx:"

# Multiconfig Setting
BBMULTICONFIG += "k3r5"

# Select expected version for u-boot-tools package
PREFERRED_VERSION_u-boot-tools-native ?= "2023.01"

# Enable support for fitImage
KERNEL_IMAGETYPES = "Image fitImage"
KERNEL_CLASSES += "kernel-fitimage"
UBOOT_ENTRYPOINT = "0x81000000"
UBOOT_LOADADDRESS = "0x81000000"
UBOOT_RD_LOADADDRESS = "0x84000000"
UBOOT_RD_ENTRYPOINT = "0x84000000"
UBOOT_DTB_LOADADDRESS = "0x83000000"
UBOOT_DTBO_LOADADDRESS = "0x83080000"

# SPL binary related parameters
SPL_BINARY = "tispl.bin"
SPL_BINARYNAME = "tispl.bin"
UBOOT_SUFFIX = "img"

# Enable kernel signature
UBOOT_SIGN_ENABLE = "1"
UBOOT_MKIMAGE_DTCOPTS = "-I dts -O dtb"
UBOOT_SIGN_KEYNAME ?= "custMpk"
UBOOT_SIGN_KEYDIR ?= "${TI_SECURE_DEV_PKG}/keys"
FIT_HASH_ALG ?= "sha512"
FIT_SIGN_ALG ?= "rsa4096"
# UBOOT_SIGN_IMG_KEYNAME is set, so generate it automatically.
# This is an improvement for TI kernel signature strategy.
FIT_GENERATE_KEYS = "1"
FIT_SIGN_INDIVIDUAL = "1"
UBOOT_SIGN_IMG_KEYNAME = "custMpkImage"

# ATF parameters
TFA_PLATFORM = "k3"
TFA_K3_SYSTEM_SUSPEND = "1"
TFA_BOARD = "lite"
OPTEEMACHINE = "k3-am62x"

# Install essential bootloader images
IMAGE_BOOT_FILES:append = " ${SPL_BINARYNAME} u-boot.${UBOOT_SUFFIX} tiboot3.bin"
# Default tiboot3.bin on AM62A is for HS-FS
IMAGE_BOOT_FILES:append = " tiboot3-am62ax-hs-fs-evm.bin"
# Since default tiboot3.bin on AM62A is for HS-FS, add a version for GP
IMAGE_BOOT_FILES:append = " tiboot3-am62ax-gp-evm.bin"
# Since default tiboot3.bin on AM62A is for HS-FS, add a version for HS-SE
IMAGE_BOOT_FILES:append = " tiboot3-am62ax-hs-evm.bin"
# Install fitImage
IMAGE_INSTALL:append = " kernel-image-fitimage"
IMAGE_BOOT_FILES:append = " fitImage"

# Set the dependency of generating wic image.
do_image_wic[depends] += "u-boot-ti-staging:do_deploy"
do_image[mcdepends] += "mc::k3r5:u-boot-ti-staging:do_deploy"

# remove trusted-firmware-a-ti.inc quotation, because there are same configurations in the bbappend of BSP layer
TFA_TI:remove = "trusted-firmware-a-ti.inc"
```

## conf/machine/ti-am62.conf
```bitbake
#@TYPE: Machine
#@NAME: ti-am62
#@DESCRIPTION: Machine configuration for TI AM62A SoC

require conf/machine/ti-am62.inc
DTB_FILES = "k3-am62a7-sk.dtb k3-am62x-sk-csi2-imx219.dtbo k3-am62a7-sk-ethernet-dc01.dtbo"
KERNEL_DEVICETREE = "${@''.join('ti/%s ' % d for d in '${DTB_FILES}'.split())}"
IMAGE_BOOT_FILES ?= " Image u-boot.img ${DTB_FILES} uEnv.txt"
UBOOT_MACHINE = "am62ax_evm_a53_defconfig"
DEFAULT_DTB ?= "k3-am62a7-sk.dtb"
OPTEEMACHINE = "k3-am62x"
TFA_BOARD = "lite"

# Add extra essential overrides
MACHINEOVERRIDES:prepend = "${@bb.utils.contains("MACHINE_FEATURES", "secure-boot", "k3:am62axx:", "", d)}"

# Enable kernel signature
UBOOT_SIGN_ENABLE = "${@bb.utils.contains("MACHINE_FEATURES", "secure-boot", "1", "0", d)}"
```

## conf/machine/ti-am62.inc
```bitbake
#@TYPE: Machine inc.
#@NAME: ti-am62

BBMULTICONFIG += " k3r5"
DEFAULTTUNE = "cortexa53"
require conf/machine/include/arm/armv8a/tune-cortexa53.inc

MACHINEOVERRIDES:prepend = "am62axx-evm:am62axx:"

MACHINE_FEATURES += "ext3 pci usbgadget usbhost vfat keyboard network"

DISTRO_FEATURES:append = " vfat serial emmc SD"

KERNEL_IMAGETYPE = ""
KERNEL_IMAGETYPES = "Image.gz Image"

SERIAL_CONSOLE = "115200 ttyS0"

MACHINE_EXTRA_RRECOMMENDS = " kernel-modules kernel-devicetree"
IMAGE_FSTYPES += "tar.bz2 wic wic.bmap"
WKS_FILE ?= "am62-sdimage.wks"
IMAGE_INSTALL:append = " kernel-devicetree kernel-image-image"
do_image_wic[depends] += " mtools-native:do_populate_sysroot dosfstools-native:do_populate_sysroot u-boot-ti-staging:do_deploy"
do_image[mcdepends] += "mc::k3r5:u-boot-ti-staging:do_deploy"

KERNEL_DTBDEST = "${KERNEL_IMAGEDEST}/dtb"
KERNEL_DTBVENDORED = "1"

# multilib support
MULTILIBS ?= "multilib:lib32"
DEFAULTTUNE:virtclass-multilib-lib32 ?= "armv7athf-neon"
PREFERRED_PROVIDER_virtual/kernel ??= "linux-yocto"
PREFERRED_VERSION_linux-yocto ?= "6.1%"
MACHINE_EXTRA_RRECOMMENDS += "linux-firmware-cnm"

NON_MULTILIB_RECIPES:append = " u-boot-ti-staging optee-os trusted-firmware-a ti-rtos-firmware ti-dm-fw ti-eth-fw ti-k3-secdev tisdk-uenv"
```
